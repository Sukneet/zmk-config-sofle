## config/west.yml
```yaml
manifest:
  remotes:
    - name: zmkfirmware
      url-base: https://github.com/zmkfirmware
    - name: Sukneet
      url-base: https://github.com/Sukneet
    - name: tklzg
      url-base: https://github.com/tklzg
  projects:
    - name: zmk
      remote: Sukneet
      revision: encoder
      import: app/west.yml
  self:
    path: config
```
